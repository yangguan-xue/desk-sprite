## firmware/main/Kconfig.projbuild
```kconfig
menu "Desk Sprite Configuration"

    config SPRITE_MQTT_BROKER_URL
        string "MQTT Broker URI"
        default "mqtt://127.0.0.1:1883"
        help
            URI of the MQTT broker, e.g. mqtt://192.168.1.100:1883 or mqtts://...

    config SPRITE_MQTT_CA_CERT
        string "Custom CA Certificate (PEM format or empty to use ESP x509 Bundle)"
        default ""
        help
            Optional PEM-formatted CA certificate used to verify the MQTT broker.
            If left empty, the built-in ESP x509 Certificate Bundle (esp_crt_bundle_attach) will be used.

    config SPRITE_MQTT_BROKER_COMMON_NAME
        string "Server Certificate Common Name"
        default ""
        help
            Expected common name (CN) of the broker's TLS certificate.
            If left empty, the host from the broker URI is matched.

    config SPRITE_DEVICE_ID
        string "Device ID"
        default "esp32_c049ef"
        help
            Unique device ID for Desk Sprite.

    config SPRITE_SNTP_SERVER
        string "SNTP Server"
        default "pool.ntp.org"
        help
            SNTP server to sync clock.

    config SPRITE_ENABLE_TOUCH_ACTIONS
        bool "Enable Native Touch Action Reporting"
        default n
        help
            Enable physical touch action reporting to cloud. Defaults to disabled
            per SPEC-005/007 until physical capacitance calibration is accepted.

endmenu
```

## firmware/sdkconfig.defaults
```kconfig
# Desk Sprite ESP32-S3 Board Configuration
CONFIG_IDF_TARGET="esp32s3"

# CPU & Clock
CONFIG_ESP32S3_DEFAULT_CPU_FREQ_240=y
CONFIG_ESP32S3_DEFAULT_CPU_FREQ_MHZ=240

# Octal PSRAM (8MB)
CONFIG_SPIRAM=y
CONFIG_SPIRAM_MODE_OCT=y
CONFIG_SPIRAM_TYPE_ESP32S3=y
CONFIG_SPIRAM_SPEED_80M=y
CONFIG_SPIRAM_MEMTEST=y

# Flash Size (8MB for Physical Board)
CONFIG_ESPTOOLPY_FLASHSIZE_8MB=y
CONFIG_ESPTOOLPY_FLASHMODE_DIO=y
CONFIG_ESPTOOLPY_FLASHFREQ_80M=y

# FreeRTOS & System
CONFIG_FREERTOS_HZ=1000
CONFIG_ESP_SYSTEM_EVENT_TASK_STACK_SIZE=4096
CONFIG_ESP_MAIN_TASK_STACK_SIZE=8192
CONFIG_ESP_CONSOLE_USB_SERIAL_JTAG=y

# LVGL Integration
CONFIG_LV_COLOR_DEPTH_16=y
CONFIG_LV_COLOR_16_SWAP=y
CONFIG_LV_HOR_RES_MAX=240
CONFIG_LV_VER_RES_MAX=240
CONFIG_LV_DISP_DEF_REFR_PERIOD=30

# Certificate Bundle (Use common root CAs for ~50% flash savings, R5-01)
CONFIG_MBEDTLS_CERTIFICATE_BUNDLE=y
CONFIG_MBEDTLS_CERTIFICATE_BUNDLE_DEFAULT_CMN=y
```

## tools/board_probe/sdkconfig.defaults
```kconfig
CONFIG_IDF_TARGET="esp32s3"
CONFIG_APP_BUILD_TYPE_RAM=y
CONFIG_APP_BUILD_TYPE_PURE_RAM_APP=y
CONFIG_ESP_CONSOLE_USB_SERIAL_JTAG=y
CONFIG_ESP_CONSOLE_SECONDARY_NONE=y
CONFIG_ESP_SYSTEM_PANIC_PRINT_REBOOT=y
CONFIG_ESP_MAIN_TASK_STACK_SIZE=6144
CONFIG_NEWLIB_NANO_FORMAT=y
CONFIG_COMPILER_OPTIMIZATION_SIZE=y
CONFIG_LOG_DEFAULT_LEVEL_INFO=y
```
